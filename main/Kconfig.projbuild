## main/Kconfig.projbuild
```kconfig
menu "ESP32 Webhook Sender Configuration"

    config EXAMPLE_WIFI_SSID
        string "WiFi SSID"
        default "myssid"
        help
            SSID (network name) for the device to connect to.

    config EXAMPLE_WIFI_PASSWORD
        string "WiFi Password"
        default "mypassword"
        help
            WiFi password (WPA or WPA2) for the device.

    config EXAMPLE_FIRMWARE_UPGRADE_URL
        string "Firmware Upgrade URL"
        default "http://192.168.1.100:8080/firmware.bin"
        help
            URL of firmware to download for OTA updates.

endmenu
```
